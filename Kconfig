## components/trace/Kconfig
```kconfig
# Copyright (c) 2026 Kyland Inc.
# Intewell-RTOS is licensed under Mulan PSL v2.
# You can use this software according to the terms and conditions of the Mulan PSL v2.
# You may obtain a copy of Mulan PSL v2 at:
#          http://license.coscl.org.cn/MulanPSL2
# THIS SOFTWARE IS PROVIDED ON AN "AS IS" BASIS, WITHOUT WARRANTIES OF ANY KIND,
# EITHER EXPRESS OR IMPLIED, INCLUDING BUT NOT LIMITED TO NON-INFRINGEMENT,
# MERCHANTABILITY OR FIT FOR A PARTICULAR PURPOSE.
# See the Mulan PSL v2 for more details.

menuconfig TRACE
    bool "System Tracing Support"
    default n
    help
      Enable system-wide tracing functionality for debugging and performance
      analysis. This provides detailed logs of system events.

if TRACE

config TRACE_BOOT
    bool "Boot-time Tracing"
    default n
    help
      Enable tracing from the earliest boot stage, before normal
      subsystems are initialized.
      This allows capturing trace data for early init functions,
      system bring-up, and kernel start sequence.

config TRACE_MARK
    bool "Mark Point Tracing"
    default y
    help
      Trace mark begin/end points for performance measurement.

config TRACE_IRQ
    bool "IRQ Tracing"
    default y
    help
      Trace interrupt request events with timing information.

config TRACE_SYSCALL
    bool "System Call Tracing"
    default y
    help
      Trace system call entries and exits.

config TRACE_SIGNAL
    bool "Signal Tracing"
    default y
    help
      Trace signal generation and delivery events.

config TRACE_COMPETE
    bool "Trace Resource Competition"
    depends on TRACE
    default y
    help
      Trace resource competition and contention events. This includes:
      - Mutex/semaphore acquisition and release
      - Spinlock operations
      - Resource waiting queues
      - Priority inversion detection
      - Deadlock potential warnings

      This tracing helps identify performance bottlenecks and potential
      deadlock situations in multi-threaded environments.

config TRACE_LOG
    bool "Log Tracing"
    default y
    help
      Trace log messages with different severity levels.

config TRACE_MEMORY
    bool "Memory Allocation Tracing"
    default y
    help
      Trace memory allocation and free operations.

endif
```

## drivers/bch/Kconfig
```kconfig
# Copyright (c) 2026 Kyland Inc.
# Intewell-RTOS is licensed under Mulan PSL v2.
# You can use this software according to the terms and conditions of the Mulan PSL v2.
# You may obtain a copy of Mulan PSL v2 at:
#          http://license.coscl.org.cn/MulanPSL2
# THIS SOFTWARE IS PROVIDED ON AN "AS IS" BASIS, WITHOUT WARRANTIES OF ANY KIND,
# EITHER EXPRESS OR IMPLIED, INCLUDING BUT NOT LIMITED TO NON-INFRINGEMENT,
# MERCHANTABILITY OR FIT FOR A PARTICULAR PURPOSE.
# See the Mulan PSL v2 for more details.

#
# For a description of the syntax of this configuration file,
# see the file kconfig-language.txt in the NuttX tools repository.
#

menuconfig BCH
	bool "Block-to-Character (BCH) Support"
	default n
	---help---
		Contains logic that may be used to convert a block driver into
		a character driver.  This is the complementary conversion as that
		performed by loop.c.  See include/nuttx/drivers/drivers.h for
		registration information.

if BCH

config BCH_ENCRYPTION
	bool "Enable BCH encryption"
	default n
	depends on CRYPTO_AES

config BCH_ENCRYPTION_KEY_SIZE
	int "AES key size"
	default 16
	depends on BCH_ENCRYPTION

config BCH_BUFFER_ALIGNMENT
	int "Buffer aligned bytes"
	default 0

endif # BCH
```

## drivers/dts/Kconfig
```kconfig
# Copyright (c) 2026 Kyland Inc.
# Intewell-RTOS is licensed under Mulan PSL v2.
# You can use this software according to the terms and conditions of the Mulan PSL v2.
# You may obtain a copy of Mulan PSL v2 at:
#          http://license.coscl.org.cn/MulanPSL2
# THIS SOFTWARE IS PROVIDED ON AN "AS IS" BASIS, WITHOUT WARRANTIES OF ANY KIND,
# EITHER EXPRESS OR IMPLIED, INCLUDING BUT NOT LIMITED TO NON-INFRINGEMENT,
# MERCHANTABILITY OR FIT FOR A PARTICULAR PURPOSE.
# See the Mulan PSL v2 for more details.

config DTB_BUILTIN
    bool "Enable built-in Device Tree (DTB)"
    depends on !X86_64
    default y
    help
      If enabled, a DTB file will be packaged into the firmware image as a
      built-in blob. If disabled, DTB must be provided by bootloader or
      loaded externally at runtime.
```

## drivers/irqchip/Kconfig
```kconfig
# Copyright (c) 2026 Kyland Inc.
# Intewell-RTOS is licensed under Mulan PSL v2.
# You can use this software according to the terms and conditions of the Mulan PSL v2.
# You may obtain a copy of Mulan PSL v2 at:
#          http://license.coscl.org.cn/MulanPSL2
# THIS SOFTWARE IS PROVIDED ON AN "AS IS" BASIS, WITHOUT WARRANTIES OF ANY KIND,
# EITHER EXPRESS OR IMPLIED, INCLUDING BUT NOT LIMITED TO NON-INFRINGEMENT,
# MERCHANTABILITY OR FIT FOR A PARTICULAR PURPOSE.
# See the Mulan PSL v2 for more details.

menu "Irqchip Select"
    
config GIC_VERSION_V3
    bool "ARM GIC-V3 driver"
    default y
    depends on ARM_64 || ARM_32
    help
      This selects the ARM gic-v3 driver.

config GIC_VERSION_V2
    bool "ARM GIC-V2 driver"
    default n
    depends on ARM_64 || ARM_32
    help
      This selects the ARM gic-v2 driver.

endmenu
```

## drivers/pty/Kconfig
```kconfig
menuconfig PSEUDOTERM
	bool "Pseudo-Terminal (PTY) support"
	default n
	select PIPES
	select ARCH_HAVE_SERIAL_TERMIOS
	---help---
		Enable support support for master and slave pseudo-terminal devices.

if PSEUDOTERM

config PSEUDOTERM_SUSV1
	bool "SUSv1 style"
	default y
	---help---
		PTYs as specified in the Single Unix Specification (SUSv1).

		Master: /dev/ptmx (multiplexor)
		Slave: /dev/pts/N

		Where N is the minor number

config PSEUDOTERM_RXBUFSIZE
	int "Pseudo-Terminal Rx buffer size"
	default 256
	---help---
		Master-to-slave pipe buffer size.  Default: 256

config PSEUDOTERM_TXBUFSIZE
	int "Pseudo-Terminal Tx buffer size"
	default 256
	---help---
		Slave-to-master pipe buffer size.  Default: 256

endif # PSEUDOTERM
```

## drivers/serial/Kconfig
```kconfig
# Copyright (c) 2026 Kyland Inc.
# Intewell-RTOS is licensed under Mulan PSL v2.
# You can use this software according to the terms and conditions of the Mulan PSL v2.
# You may obtain a copy of Mulan PSL v2 at:
#          http://license.coscl.org.cn/MulanPSL2
# THIS SOFTWARE IS PROVIDED ON AN "AS IS" BASIS, WITHOUT WARRANTIES OF ANY KIND,
# EITHER EXPRESS OR IMPLIED, INCLUDING BUT NOT LIMITED TO NON-INFRINGEMENT,
# MERCHANTABILITY OR FIT FOR A PARTICULAR PURPOSE.
# See the Mulan PSL v2 for more details.

menu "Serial"

config SERIAL_TXDMA
    bool "Serial TX DMA"
    default n

config SERIAL_RXDMA
    bool "Serial RX DMA"
    default n

config UART_TX_BUF_SIZE
    hex "Serial Tx Buf Size"
    default 0x400

config UART_RX_BUF_SIZE
    hex "Serial Rx Buf Size"
    default 0x400

config UART_BAUD
    int "Setial bandrate"
    default 115200

config UART_CLK
    int "Setial clk"
    default 24000000

config UART_PL011
    bool "ARM PL011 UART driver"
    depends on !QEMU_X86_64
    default y if !QEMU_X86_64
    help
      This selects the ARM(R) AMBA(R) PrimeCell PL011 UART.

config UART_I8250
    bool "x86_64 i8250 uart driver"
    depends on ARCH_X86_64
    default y if ARCH_X86_64
    help
        Enable support for the i8250 UART driver on x86_64 systems.

config FORCE_COM_NR
    int "Force COM numbers"
    default 0
    depends on UART_I8250
    help
        Force register UART in x86_64

endmenu
```

## drivers/virtio/Kconfig
```kconfig
# Copyright (c) 2026 Kyland Inc.
# Intewell-RTOS is licensed under Mulan PSL v2.
# You can use this software according to the terms and conditions of the Mulan PSL v2.
# You may obtain a copy of Mulan PSL v2 at:
#          http://license.coscl.org.cn/MulanPSL2
# THIS SOFTWARE IS PROVIDED ON AN "AS IS" BASIS, WITHOUT WARRANTIES OF ANY KIND,
# EITHER EXPRESS OR IMPLIED, INCLUDING BUT NOT LIMITED TO NON-INFRINGEMENT,
# MERCHANTABILITY OR FIT FOR A PARTICULAR PURPOSE.
# See the Mulan PSL v2 for more details.

#
# For a description of the syntax of this configuration file,
# see the file kconfig-language.txt in the NuttX tools repository.
#

menuconfig DRIVERS_VIRTIO
	bool "Virtio Device Support"
	default n

if DRIVERS_VIRTIO
config VIRTIO_MMIO
	bool "Virtio MMIO Support"
	default y

config DRIVERS_VIRTIO_MMIO_QUEUE_LEN
	int "Queue length"
	depends on VIRTIO_MMIO
	default 256

config VIRTIO_MMIO_BLK
	bool "Virtio MMIO Block Support"
	default y

config VIRTIO_CONSOLE
	bool "Virtio Console Support"
	select SERIAL_TXDMA
	select SERIAL_RXDMA
	default y

config VIRTIO_PCI
	bool "Virtio Pci Support"
	default y

config VIRTIO_MMIO_NET
	bool "Virtio MMIO Net Support"
	depends on NETWORK
	default y

if VIRTIO_MMIO_NET
config VIRTIO_NET_SUPPORT_AF_PACKET
	bool "Enables The Use Of AF_PACKET Socket To Receive non-IP Protocol Packets"
	default y
	help
	  Enables Virtio-Net To Receive non-IP Protocol Packets Using The AF_PACKET Socket.
endif

endif
```

## kernel/init/cpio/Kconfig
```kconfig
# Copyright (c) 2026 Kyland Inc.
# Intewell-RTOS is licensed under Mulan PSL v2.
# You can use this software according to the terms and conditions of the Mulan PSL v2.
# You may obtain a copy of Mulan PSL v2 at:
#          http://license.coscl.org.cn/MulanPSL2
# THIS SOFTWARE IS PROVIDED ON AN "AS IS" BASIS, WITHOUT WARRANTIES OF ANY KIND,
# EITHER EXPRESS OR IMPLIED, INCLUDING BUT NOT LIMITED TO NON-INFRINGEMENT,
# MERCHANTABILITY OR FIT FOR A PARTICULAR PURPOSE.
# See the Mulan PSL v2 for more details.

menu "rootfs"

choice
    prompt "rootfs 初始化方法"
    default ROOTFS_EXT4

config ROOTFS_EXT4
    bool "ext4fs"

config ROOTFS_CPIO
    bool "cpio init ramfs support"
    select FS_RAMFS
endchoice

config INIT_PROCESS_NAME
    string "init process name"
    default "/sbin/init"

config INITRAMFS_SOURCE
    string "cpio initramfs path"
    depends on ROOTFS_CPIO
    default "./initrd.cpio.default"
    help
      必须指定cpio文件的路径，该文件将在编译时被链接进内核。
      路径是相对于build目录的相对路径

endmenu
```

## kernel/memory/Kconfig
```kconfig
# Copyright (c) 2026 Kyland Inc.
# Intewell-RTOS is licensed under Mulan PSL v2.
# You can use this software according to the terms and conditions of the Mulan PSL v2.
# You may obtain a copy of Mulan PSL v2 at:
#          http://license.coscl.org.cn/MulanPSL2
# THIS SOFTWARE IS PROVIDED ON AN "AS IS" BASIS, WITHOUT WARRANTIES OF ANY KIND,
# EITHER EXPRESS OR IMPLIED, INCLUDING BUT NOT LIMITED TO NON-INFRINGEMENT,
# MERCHANTABILITY OR FIT FOR A PARTICULAR PURPOSE.
# See the Mulan PSL v2 for more details.

menu "memory"

choice
    prompt "memory alloc algorithm"
    default TLSF
	
config TLSF
    bool "tlsf"

config WORKSPACE
    bool "ttosworkspace"

config SLUB
    bool "Slub"
	
endchoice

if !SLUB

config KERNEL_HEAP_SIZE
    hex "kernel heap size"
    default 0x10000000

config KERNEL_NC_HEAP_SIZE
    hex "kernel DMA heap size"
    default 0x100000

endif

config MM_UBSAN
	bool "Undefined Behavior Sanitizer"
	default n
	---help---
		UBSan is a fast undefined behavior detector. UBSan modifies
		the program at compile-time to catch various kinds of
		undefined behavior during program execution

config MM_UBSAN_ALL
	bool "Enable UBSan for the entire image"
	depends on MM_UBSAN
	default y
	---help---
		This option activates UBSan instrumentation for the
		entire image. If you don't enable this option, you have to
		explicitly specify "-fsanitize=undefined" for
		the files/directories you want to check. Enabling this option
		will get image size increased and performance decreased
		significantly.

config MM_UBSAN_OPTION
	string "UBSan options"
	depends on MM_UBSAN
	default "-fsanitize=undefined"
	---help---
		This option activates specified UBSan instrumentation. Please
		refer to https://clang.llvm.org/docs/UndefinedBehaviorSanitizer.html
		for available options.

config MM_UBSAN_TRAP_ON_ERROR
	bool "Enable UBSan trap on error to crash immediately"
	depends on MM_UBSAN
	default n
	---help---
		The undefined instruction trap should cause your program to crash,
		save the code space significantly.

endmenu
```
