## Kconfig
```kconfig
# Copyright (c) 2026 Kyland Inc.
# Intewell-RTOS is licensed under Mulan PSL v2.
# You can use this software according to the terms and conditions of the Mulan PSL v2.
# You may obtain a copy of Mulan PSL v2 at:
#          http://license.coscl.org.cn/MulanPSL2
# THIS SOFTWARE IS PROVIDED ON AN "AS IS" BASIS, WITHOUT WARRANTIES OF ANY KIND,
# EITHER EXPRESS OR IMPLIED, INCLUDING BUT NOT LIMITED TO NON-INFRINGEMENT,
# MERCHANTABILITY OR FIT FOR A PARTICULAR PURPOSE.
# See the Mulan PSL v2 for more details.

mainmenu "SDK 配置"

rsource "build-env/Kconfig/Kconfig"
rsource "kernel/Kconfig"
rsource "drivers/Kconfig"
rsource "components/Kconfig"
rsource "dependencies/Kconfig"
rsource "boards-iprj/Kconfig"
```

## arch/arm_common/Kconfig
```kconfig
# Copyright (c) 2026 Kyland Inc.
# Intewell-RTOS is licensed under Mulan PSL v2.
# You can use this software according to the terms and conditions of the Mulan PSL v2.
# You may obtain a copy of Mulan PSL v2 at:
#          http://license.coscl.org.cn/MulanPSL2
# THIS SOFTWARE IS PROVIDED ON AN "AS IS" BASIS, WITHOUT WARRANTIES OF ANY KIND,
# EITHER EXPRESS OR IMPLIED, INCLUDING BUT NOT LIMITED TO NON-INFRINGEMENT,
# MERCHANTABILITY OR FIT FOR A PARTICULAR PURPOSE.
# See the Mulan PSL v2 for more details.

config SMP
	bool "smp"
	default y
	
config MAX_CPUS
	int "support cpu max numbers"
	default 8
	depends on SMP
	---help---
		config support cpu numbers

config CPU_USAGE_MONITOR
	bool "cpu usage monitor"
	default y
	---help---
		config cpu usage monitor

config IPI_TEST_HWIRQ
	int "ipi test hwirq"
	default 4
	---help---
		config ipi test hwirq
```

## boards-iprj/configs/qemu_aarch64_defconfig
```kconfig
# Copyright (c) 2026 Kyland Inc.
# Intewell-RTOS is licensed under Mulan PSL v2.
# You can use this software according to the terms and conditions of the Mulan PSL v2.
# You may obtain a copy of Mulan PSL v2 at:
#          http://license.coscl.org.cn/MulanPSL2
# THIS SOFTWARE IS PROVIDED ON AN "AS IS" BASIS, WITHOUT WARRANTIES OF ANY KIND,
# EITHER EXPRESS OR IMPLIED, INCLUDING BUT NOT LIMITED TO NON-INFRINGEMENT,
# MERCHANTABILITY OR FIT FOR A PARTICULAR PURPOSE.
# See the Mulan PSL v2 for more details.

CONFIG_TOOLCHAIN_GCC=y
CONFIG_TARGET_CPU_CORTEX_A53=y
CONFIG_BUILD_OPTIMIZE="2"
CONFIG_QEMU_AARCH64=y
CONFIG_KERNEL_PROCESS_STACKSIZE=0x100000
CONFIG_GIC_VERSION_V2=y
CONFIG_BCH=y
CONFIG_DRIVERS_VIRTIO=y
CONFIG_PSEUDOTERM=y
CONFIG_PSEUDOTERM_RXBUFSIZE=4096
CONFIG_PSEUDOTERM_TXBUFSIZE=4096
CONFIG_PSEUDOFS_SOFTLINKS=y
CONFIG_FS_LWEXT4=y
CONFIG_NFS=y
CONFIG_FS_TMPFS=y
CONFIG_FS_SHMFS=y
CONFIG_FS_PROCFS=y
CONFIG_ALLSYMS=y
CONFIG_QEMU_AARCH64=y
CONFIG_DTB_QEMU_AARCH64=y
CONFIG_TRACE=y
CONFIG_TRACE_MARK=y
CONFIG_TRACE_IRQ=y
CONFIG_TRACE_SYSCALL=y
CONFIG_TRACE_SIGNAL=y
CONFIG_TRACE_COMPETE=y
CONFIG_TRACE_LOG=y
CONFIG_TRACE_MEMORY=y
```

## build-env/Kconfig/target/Kconfig
```kconfig
# Copyright (c) 2026 Kyland Inc.
# Intewell-RTOS is licensed under Mulan PSL v2.
# You can use this software according to the terms and conditions of the Mulan PSL v2.
# You may obtain a copy of Mulan PSL v2 at:
#          http://license.coscl.org.cn/MulanPSL2
# THIS SOFTWARE IS PROVIDED ON AN "AS IS" BASIS, WITHOUT WARRANTIES OF ANY KIND,
# EITHER EXPRESS OR IMPLIED, INCLUDING BUT NOT LIMITED TO NON-INFRINGEMENT,
# MERCHANTABILITY OR FIT FOR A PARTICULAR PURPOSE.
# See the Mulan PSL v2 for more details.

menu "目标配置"

    choice
        prompt "编译器"
        default TOOLCHAIN_CLANG

        config TOOLCHAIN_CLANG
            bool "clang"

        config TOOLCHAIN_GCC
            bool "gcc"
    endchoice

    config ARCH_ARMv7
        bool
        select ARM_32
        default n

    config ARCH_AARCH32
        bool
        select ARM_32
        default n

    config ARCH_AARCH64
        bool
        select ARM_64
        default n

    config ARCH_X86_64
        bool
        select X86_64
        default n

    config ARM_32
        bool
        select OS_LP32
        select ARCH_ARM
        default n

    config ARM_64
        bool
        select OS_LP64
        select ARCH_ARM
        default n

    config X86_64
        bool
        select OS_LP64
        default n

    config OS_LP32
        bool
        default n

    config OS_LP64
        bool
        default n

    config ARCH_ARM
        bool
        default n

    choice
        prompt "处理器架构"
        default CHOICE_ARCH_AARCH64

        config CHOICE_ARCH_ARMv7
            bool "ARMv7-A"
            select ARCH_ARMv7

        config CHOICE_ARCH_AARCH32
            bool "ARMv8-aarch32"
        select ARCH_AARCH32

        config CHOICE_ARCH_AARCH64
            bool "ARMv8-aarch64"
            select ARCH_AARCH64

        config CHOICE_ARCH_X86_64
            bool "x86_64"
            select ARCH_X86_64
    endchoice

    if ARCH_AARCH64 || ARCH_AARCH32
        choice
            prompt "CPU"
            default TARGET_CPU_CORTEX_A55

            config TARGET_CPU_CORTEX_A55
                bool "Cortex-A55"
            config TARGET_CPU_CORTEX_A53
                bool "Cortex-A53"
        endchoice
    endif

    if ARCH_ARMv7
        choice
            prompt "CPU"
            default TARGET_CPU_CORTEX_A15

            config TARGET_CPU_CORTEX_A15
                bool "Cortex-A15"
            config TARGET_CPU_CORTEX_A9
                bool "Cortex-A9"
            config TARGET_CPU_CORTEX_A7
                bool "Cortex-A7"
        endchoice
    endif

config KERNEL_SPACE_START
    hex "kernel space start address"
    default 0xC0000000  if ARM_32
    default 0xFFFF000000000000  if ARM_64
    default 0xFFFF800000000000  if X86_64
    help
        This is for kernel start virtual address. Depends on the architecture:
        - ARM 32-bit: 0xC0000000
        - ARM 64-bit: 0xFFFF000000000000
        - X86_64: 0xFFFF800000000000

    config ARCH
        string
        default "aarch64" if ARCH_AARCH64
        default "arm" if ARCH_AARCH32
        default "arm" if ARCH_ARMv7
        default "x86_64" if ARCH_X86_64

    config SUB_ARCH
        string
        default "" if ARCH_AARCH64 || ARCH_AARCH32
        default "x86_64" if ARCH_X86_64

if ARCH_AARCH64 || ARCH_AARCH32 || ARCH_ARMv7
    # ARM-family shared options now live under arm_common.
    source "arch/arm_common/Kconfig"
endif

    config BUILD_OPTIMIZE
        string "Optimize level for build"
        default "0"

    config BUILD_DEBUG_INFO
        bool "debug info for build"
        default y

    menu "Hardware"
        config ISR_STACK_SIZE
            hex "Config isr stack size"
            default 0x2000

        config HARD_FLOAT
            bool "Enable Hard Float Unit"
            default y

if ARCH_X86_64
        config KERNEL_LOAD_PHYS_ADDR
            hex "Kernel load physical address"
            default 0x400000
            help
            This gives the physical address where the kernel image is loaded.
endif
    endmenu

endmenu
```

## components/acpi/Kconfig
```kconfig
# Copyright (c) 2026 Kyland Inc.
# Intewell-RTOS is licensed under Mulan PSL v2.
# You can use this software according to the terms and conditions of the Mulan PSL v2.
# You may obtain a copy of Mulan PSL v2 at:
#          http://license.coscl.org.cn/MulanPSL2
# THIS SOFTWARE IS PROVIDED ON AN "AS IS" BASIS, WITHOUT WARRANTIES OF ANY KIND,
# EITHER EXPRESS OR IMPLIED, INCLUDING BUT NOT LIMITED TO NON-INFRINGEMENT,
# MERCHANTABILITY OR FIT FOR A PARTICULAR PURPOSE.
# See the Mulan PSL v2 for more details.

config ACPI
    bool "Enable ACPI Support"
    default n if !ARCH_X86_64
    default y if ARCH_X86_64
    help
        Enable support for ACPI

config ACPI_DEBUG
    bool "Enable ACPI Debug"
    default n
    depends on ACPI
    help
        Enable support for ACPI Debug
```

## components/libelf/Kconfig
```kconfig
# Copyright (c) 2026 Kyland Inc.
# Intewell-RTOS is licensed under Mulan PSL v2.
# You can use this software according to the terms and conditions of the Mulan PSL v2.
# You may obtain a copy of Mulan PSL v2 at:
#          http://license.coscl.org.cn/MulanPSL2
# THIS SOFTWARE IS PROVIDED ON AN "AS IS" BASIS, WITHOUT WARRANTIES OF ANY KIND,
# EITHER EXPRESS OR IMPLIED, INCLUDING BUT NOT LIMITED TO NON-INFRINGEMENT,
# MERCHANTABILITY OR FIT FOR A PARTICULAR PURPOSE.
# See the Mulan PSL v2 for more details.

config ALLSYMS
	bool "Load all symbols for debugging"
	default n
	---help---
		Say Y here to let print out symbolic crash information and
		symbolic stack backtraces. This increases the size of the
		somewhat, as all symbols have to be loaded into the image.

config SYMTAB_ORDEREDBYNAME
	bool "Symbol Tables Ordered by Name"
	default n
	---help---
		Select if the symbol table is ordered by symbol name.  In this case,
		the logic can perform faster lookups using a binary search.
		Otherwise, the symbol table is assumed to be un-ordered and only
		slow, linear searches are supported.

config SYMTAB_ORDEREDBYVALUE
	bool "Symbol Tables Ordered by Value"
	default n
	---help---
		Select if the symbol table is ordered by symbol value.

config SYMTAB_DECORATED
	bool "Symbols are decorated with leading underscores"
	default n
	---help---
		Select if symbols in relocatable objects are decorated with a leading
		underscore. This option will remove the underscore from symbol names
		when relocating a loadable object.
```

## components/log/Kconfig
```kconfig
# Copyright (c) 2026 Kyland Inc.
# Intewell-RTOS is licensed under Mulan PSL v2.
# You can use this software according to the terms and conditions of the Mulan PSL v2.
# You may obtain a copy of Mulan PSL v2 at:
#          http://license.coscl.org.cn/MulanPSL2
# THIS SOFTWARE IS PROVIDED ON AN "AS IS" BASIS, WITHOUT WARRANTIES OF ANY KIND,
# EITHER EXPRESS OR IMPLIED, INCLUDING BUT NOT LIMITED TO NON-INFRINGEMENT,
# MERCHANTABILITY OR FIT FOR A PARTICULAR PURPOSE.
# See the Mulan PSL v2 for more details.

menu "Log"

config KLOG_BUFF_SIZE
    hex "circle buffer size for klog"
    default 0x1000000

choice
    prompt "Log level"
    default LOG_LEVEL_EMERG

    config LOG_LEVEL_DEBUG
        bool "Debug"

    config LOG_LEVEL_INFO
        bool "Info"

    config LOG_LEVEL_WARN
        bool "Warning"

    config LOG_LEVEL_ERROR
        bool "Error"

    config LOG_LEVEL_EMERG
        bool "Emerg"

endchoice

endmenu
```

## components/net/Kconfig
```kconfig
# Copyright (c) 2026 Kyland Inc.
# Intewell-RTOS is licensed under Mulan PSL v2.
# You can use this software according to the terms and conditions of the Mulan PSL v2.
# You may obtain a copy of Mulan PSL v2 at:
#          http://license.coscl.org.cn/MulanPSL2
# THIS SOFTWARE IS PROVIDED ON AN "AS IS" BASIS, WITHOUT WARRANTIES OF ANY KIND,
# EITHER EXPRESS OR IMPLIED, INCLUDING BUT NOT LIMITED TO NON-INFRINGEMENT,
# MERCHANTABILITY OR FIT FOR A PARTICULAR PURPOSE.
# See the Mulan PSL v2 for more details.

menuconfig NETWORK
	bool "Network"
	default y

config TCPIP
	bool "TCP/IP Stack"
	depends on NETWORK
	default y

choice
	prompt ""
	depends on TCPIP
	default LWIP_2_2_0

	config LWIP_2_2_0
		bool "LWIP 2.2.0"
		---help---
			Use LWIP 2.2.0
		select LWIP_EXTERNAL_LIBC
		select LWIP_IPV4
		select LWIP_TCP
		select LWIP_UDP
		select LWIP_RAW
		select LWIP_ARP
		select LWIP_IGMP
endchoice

config MAX_NETIF_IPS
	int "Maximum IP number for one device"
	depends on NETWORK
	default 32
	---help---
		Config how many IPs can be set on one device.

config NETPKT_RESERVED_LEN
	int "NETPKT Reserved Data Length"
	depends on NETWORK
	range 32 4096
	default 64
	---help---
		Config Reserved Field Length in ETH_NETPKT, used for Save struct pbuf_cunstom Currently. Must be Greater than 64 Bytes!

config NETPKT_ALIGNMENT_LEN
	int "NETPKT Alignment Length"
	depends on NETWORK
	default 64
	---help---
		Config Alignment Length when Allocating NETPKT, It Should be Aligned with the CPU Cacheline.

config ETH_RX_TASK_PRIORITY
	int "Ethernet device RX task priority"
	depends on NETWORK
	default 20
	---help---
		Ethernet device RX task priority.

config ETH_RX_TASK_STACK_SIZE
	int "Ethernet device RX task stack size"
	depends on NETWORK
	default 65536
	---help---
		Ethernet device RX task stack size.

config ETH_RX_TASK_BIND_CPU_CORE
	bool "Bind Ethernet RX Task To CPU Core"
	depends on NETWORK && SMP
	default y

config ETH_RX_TASK_AFFINITY
	int "ethernet device RX task affinity"
	depends on ETH_RX_TASK_BIND_CPU_CORE
	default 1
	---help---
		ethernet device RX task affinity.

config SUPPORT_PHY_MONITOR
	bool "Support PHY Monitor"
	depends on NETWORK
	default y

choice
	prompt "Choice Monitor Manner"
	depends on SUPPORT_PHY_MONITOR
	default MONITOR_BY_WORK_QUEUE

config MONITOR_BY_WORK_QUEUE
	bool "Use Work Queue to Monitoring PHY"

config MONITOR_BY_STANDLONE_TASK
	bool "Use Standlone Task to Monitoring PHY"

config PHY_MONITOR_TASK_PRIORITY
	int "PHY monitor task priority"
	depends on MONITOR_BY_STANDLONE_TASK
	default 253
	---help---
		PHY monitor task priority.
endchoice

config PHY_MONITOR_CHECK_PERIOD
	int "The interval at which the PHY monitor checks the PHY status, by seconds"
	depends on SUPPORT_PHY_MONITOR
	default 2
	---help---
		The interval at which the PHY monitor checks the PHY status, by seconds.

config SUPPORT_AF_PACKET
	bool "Support AF_PACKET Socket"
	depends on NETWORK
	default y

config AF_PACKET_CACHEABLE_ENTRIES
	int "Cacheble AF_PACKET Packets Entries"
	depends on SUPPORT_AF_PACKET
	default 4096

choice
	prompt "Choice Packet Type"
	depends on SUPPORT_AF_PACKET
	default SUPPORT_AF_PACKET_RECV_ARP

config SUPPORT_AF_PACKET_RECV_NON_ARP_IP
	bool "Support Receive Non-ARP/IP Packets"

config SUPPORT_AF_PACKET_RECV_ARP
	bool "Support Receive Non-IP and ARP Packets"

config SUPPORT_AF_PACKET_RECV_ALL
	bool "Support Receive All Packets"
endchoice

config SUPPORT_AF_CAN
	bool "Support AF_CAN Socket"
	depends on NETWORK
	default y

config SUPPORT_ARP_ANNOUNCEMENT
	bool "Support ARP Announcement"
	depends on NETWORK
	default y

config ARP_PHY_CHANGE_TO_LINKUP
	bool "When the PHY Status Changes to Link UP"
	depends on SUPPORT_ARP_ANNOUNCEMENT
	default y

config ARP_IP_ADDR_CHANGE
	bool "When the IP Address Changes"
	depends on SUPPORT_ARP_ANNOUNCEMENT
	default y

config SUPPORT_PCAP_TOOL
	bool "Support use pcap tool to capture ethernet network packet"
	depends on NETWORK
	default y

config PCAP_CACHEABLE_ENTRIES
	int "pcap tool cacheable entries"
	depends on SUPPORT_PCAP_TOOL
	default 1024

config USER_SHELL_NET_INIT
	bool "Support network initialization in user shell"
	depends on NETWORK
	default y

config UNIX_SOCKET
	bool "local socket"
	depends on NETWORK
	default y

config NET_LOCAL_VFS_PATH
	string "Path to local sock"
	depends on NETWORK
	default "/dev/"
	---help---
		The path to where localsock will exist in the VFS namespace.
```
